## build/conf/bblayers.conf
```bitbake
# POKY_BBLAYERS_CONF_VERSION is increased each time build/conf/bblayers.conf
# changes incompatibly
POKY_BBLAYERS_CONF_VERSION = "2"

PROJ_TOP_BBLAYER := "${@os.path.abspath(d.getVar('TOPDIR') + '/..')}"


BBPATH = "${TOPDIR}"
BBFILES ?= ""

BBLAYERS ?= " \
  ${PROJ_TOP_BBLAYER}/submodules/poky/meta \
  ${PROJ_TOP_BBLAYER}/submodules/poky/meta-poky \
  ${PROJ_TOP_BBLAYER}/submodules/poky/meta-yocto-bsp \
  ${PROJ_TOP_BBLAYER}/submodules/openembedded/meta-oe \
  ${PROJ_TOP_BBLAYER}/submodules/meta-sunxi\
  ${PROJ_TOP_BBLAYER}/meta-ntc-chip \
  "
```

## chip-build/conf/bblayers.conf
```bitbake
# LAYER_CONF_VERSION is increased each time build/conf/bblayers.conf
# changes incompatibly
PROJ_TOP_BBLAYER := "${@os.path.abspath(d.getVar('TOPDIR') + '/..')}"

LCONF_VERSION = "7"

BBPATH = "${TOPDIR}"
BBFILES ?= ""

BBLAYERS ?= " \
  ${PROJ_TOP_BBLAYER}/submodules/poky/meta            \
  ${PROJ_TOP_BBLAYER}/submodules/poky/meta-poky       \
  ${PROJ_TOP_BBLAYER}/submodules/poky/meta-yocto-bsp  \
  ${PROJ_TOP_BBLAYER}/submodules/meta-openembedded/meta-oe    \
  ${PROJ_TOP_BBLAYER}/submodules/meta-sunxi         \
  ${PROJ_TOP_BBLAYER}/submodules/meta-yachip        \
  ${PROJ_TOP_BBLAYER}/meta-chipimages               \
  "
```

## meta-ntc-chip/conf/layer.conf
```bitbake
# We have a conf and classes directory, append to BBPATH
BBPATH .= ":${LAYERDIR}"

# We have a recipes directory, add to BBFILES
BBFILES += "    \
    ${LAYERDIR}/recipes*/*/*.bb \
    ${LAYERDIR}/recipes*/*/*.bbappend \
"


BBFILE_COLLECTIONS += "ntcchip"
BBFILE_PATTERN_ntcchip = "^${LAYERDIR}/"
BBFILE_PRIORITY_ntcchip = "11"
LAYERVERSION_ntcchip = "1"

LAYERSERIES_COMPAT_ntcchip = "zeus dunfell"
```

## meta-ntc-chip/conf/machine/ntc-chip.conf
```bitbake
#@TYPE: Machine
#@NAME: Bananapi
#@DESCRIPTION: Machine configuration for the bananapi, based on allwinner A20 CPU http://bananapi.org/

require conf/machine/include/sun5i.inc

KERNEL_DEVICETREE = "sun5i-r8-chip.dtb"

# UBOOT_MACHINE = "NTC-CHIP_defconfig"
UBOOT_MACHINE = "CHIP_defconfig"

# SUNXI_FEX_FILE = "sys_config/a20/Bananapi.fex"
```

## meta-ntc-chip/recipes-bsp/uboot/files/u-boot/ya_chip_defconfig
```kconfig
CONFIG_ARM=y
CONFIG_ARCH_SUNXI=y
CONFIG_MACH_SUN5I=y
CONFIG_DRAM_TIMINGS_DDR3_800E_1066G_1333J=y
CONFIG_NR_DRAM_BANKS=1

CONFIG_NAND_SUNXI=y

CONFIG_USB0_VBUS_PIN="PB10"
CONFIG_USB_MUSB_SUNXI=y

CONFIG_DEFAULT_DEVICE_TREE="sun5i-r8-chip"

# CONFIG_VIDEO_HDMI is not set
CONFIG_VIDEO_COMPOSITE=y
CONFIG_VIDEO_LCD_MODE=""
CONFIG_VIDEO_LCD_POWER="AXP0-1"
CONFIG_VIDEO_LCD_BL_PWM="PB2"

CONFIG_SPL=y
CONFIG_SPL_I2C_SUPPORT=y
CONFIG_USE_PREBOOT=y

CONFIG_CONS_INDEX=2
CONFIG_AXP209_POWER=y
#CONFIG_ENV_IS_IN_NAND=y

# CONFIG_CMD_IMLS is not set
#CONFIG_CMD_NAND=y

CONFIG_DM_I2C=y
```
